## CMakeLists.txt
```
cmake_minimum_required(VERSION 3.20.0)

# Pull in Zephyr build system
find_package(Zephyr REQUIRED HINTS $ENV{ZEPHYR_BASE})

project(BlueSim CXX)

# Add your sources
target_sources(app PRIVATE
    src/main.cpp
    src/central/central.cpp
    src/central/scanner.cpp
    src/central/filter.cpp
    src/peripheral/advertisement.cpp
    src/peripheral/peripheral.cpp
    src/peripheral/service.cpp
    src/peripheral/characteristic.cpp
)

set_target_properties(app PROPERTIES CXX_STANDARD 17 CXX_STANDARD_REQUIRED YES)
target_compile_options(app PRIVATE $<$<COMPILE_LANGUAGE:CXX>:-fno-sized-deallocation>)
```

## Kconfig
```
menu "Role Selection"

config ROLE_CENTRAL
    bool "Enable Central Role"
    default n

config ROLE_PERIPHERAL
    bool "Enable Peripheral Role"
    default n

endmenu
```

## prj.conf
```kconfig
# Enable C++ runtime
CONFIG_CPP=y                  
CONFIG_NEWLIB_LIBC=y

# Memory / stack sizes
CONFIG_MAIN_STACK_SIZE=8192
CONFIG_SYSTEM_WORKQUEUE_STACK_SIZE=4096

# Bluetooth Core
CONFIG_BT=y
CONFIG_BT_PERIPHERAL=y
CONFIG_BT_CENTRAL=y
CONFIG_BT_EXT_ADV=y
CONFIG_BT_EXT_ADV_MAX_ADV_SET=2
CONFIG_BT_MAX_CONN=12   
CONFIG_BT_CTLR_SDC_PERIPHERAL_COUNT=6    
CONFIG_BT_ID_MAX=3   
CONFIG_BT_DEVICE_NAME_DYNAMIC=y
CONFIG_BT_CTLR_ADV_SET=3
CONFIG_BT_GATT_DYNAMIC_DB=y
CONFIG_BT_SCAN=y

# Logging
CONFIG_LOG=y
CONFIG_LOG_DEFAULT_LEVEL=0
CONFIG_UART_CONSOLE=y
CONFIG_LOG_BACKEND_UART=y         
CONFIG_LOG_MODE_IMMEDIATE=y        
CONFIG_LOG_BUFFER_SIZE=2048

# Enable crash debugging
CONFIG_ASSERT=y
CONFIG_ASSERT_LEVEL=2
```

## src/main.cpp
```c
#include "central/central.hpp"
#include "central/filter.hpp"
#include "peripheral/advertisement.hpp"
#include "peripheral/characteristic.hpp"
#include "peripheral/peripheral.hpp"
#include "peripheral/service.hpp"
#include <zephyr/logging/log.h>

extern "C" {
#include <zephyr/bluetooth/bluetooth.h>
#include <zephyr/bluetooth/conn.h>
}

LOG_MODULE_REGISTER(MAIN, LOG_LEVEL_DBG);

// Global connection callbacks that dispatch to appropriate instances
static void global_bt_conn_cb_connected(struct bt_conn *conn, uint8_t err) {
  struct bt_conn_info info;
  if (bt_conn_get_info(conn, &info) == 0) {
    if (info.role == BT_CONN_ROLE_PERIPHERAL) {
      for (uint8_t i = 0; i < MAX_PERIPHERALS; i++) {
        if (Peripheral::registry[i]) {
          if (Peripheral::registry[i]->_advertisement->_id == info.id) {
            Peripheral::registry[i]->onConnected(conn, err);
            return;
          }
        }

        LOG_WRN("No available peripheral found for connection %d", info.id);
      }
    } else if (info.role == BT_CONN_ROLE_CENTRAL) {
      for (uint8_t i = 0; i < MAX_CENTRALS; i++) {
        if (Central::registry[i]) {
          if (Central::fromConn(conn) == Central::registry[i]) {
            Central::registry[i]->onConnected(conn, err);
            return;
          }
        }
      }

      LOG_WRN("No available central found for connection");
    }
  }
}

static void global_bt_conn_cb_disconnected(struct bt_conn *conn,
                                           uint8_t reason) {
  struct bt_conn_info info;
  if (bt_conn_get_info(conn, &info) == 0) {
    if (info.role == BT_CONN_ROLE_PERIPHERAL) {
      Peripheral *peripheral = Peripheral::fromConn(conn);
      if (peripheral) {
        peripheral->onDisconnected(conn, reason);
      } else {
        LOG_ERR("Disconnected connection not associated with any peripheral");
      }
    } else if (info.role == BT_CONN_ROLE_CENTRAL) {
      Central *central = Central::fromConn(conn);
      if (central) {
        if (Central::fromConn(conn) == central) {
          central->onDisconnected(conn, reason);
          return;
        }
      } else {
        LOG_ERR("Disconnected connection not associated with any central");
      }
    }
  }
}

static struct bt_conn_cb global_conn_cb = {
    .connected = global_bt_conn_cb_connected,
    .disconnected = global_bt_conn_cb_disconnected,
};

int main() {
  int err = bt_enable(nullptr);
  if (err < 0) {
    LOG_ERR("Bluetooth init failed (err %d)", err);
    return err;
  }

  // Register global connection callbacks
  bt_conn_cb_register(&global_conn_cb);

  LOG_INF("Bluetooth initialized");

  // Wait for BLE stack to be fully ready
  k_sleep(K_MSEC(100));

  // Peripheral p1;
  Central c1;
  Central c2;

  Filter filter1;
  filter1.addGroup();
  filter1.addCriterion(FilterCriterionType::LOCAL_NAME, "Mikael1");
  c1.addFilter(filter1);

  Filter filter2;
  filter2.addGroup();
  filter2.addCriterion(FilterCriterionType::LOCAL_NAME, "Mikael2");
  c2.addFilter(filter2);

  c1.scheduleScanningStart();
  c2.scheduleScanningStart();

  // // Initialize advertisement
  // Advertisement advertisement;
  // int init_result = advertisement.init("Simulator");
  // if (init_result) {
  //   LOG_ERR("Failed to initialize advertisement (err %d)", init_result);
  //   return init_result;
  // }

  // Service service;
  // Characteristic readChar, writeChar;

  // bt_uuid_128 service_uuid = BT_UUID_INIT_128(
  //     BT_UUID_128_ENCODE(0x6e2f84f2, 0x6f5a, 0x48c4, 0x9873,
  //     0xc77acce33964));
  // bt_uuid_128 read_uuid = BT_UUID_INIT_128(
  //     BT_UUID_128_ENCODE(0x03ba1869, 0xeb49, 0x48de, 0x9213,
  //     0x508d2304e80b));
  // bt_uuid_128 write_uuid = BT_UUID_INIT_128(
  //     BT_UUID_128_ENCODE(0x4bb53da6, 0x42bc, 0x430f, 0x95fa,
  //     0xc99a44b38e14));

  // service.init(&service_uuid.uuid, "Custom Service 1");
  // readChar.init(&read_uuid.uuid, CharProperty::READ | CharProperty::NOTIFY,
  //               CharPermission::PERM_READ, "Read-notify characteristic");
  // writeChar.init(&write_uuid.uuid, CharProperty::WRITE,
  //                CharPermission::PERM_WRITE, "Write-only characteristic");

  // int result = service.addCharacteristic(&readChar);
  // if (result != 1) {
  //   LOG_ERR("Failed to add read characteristic (err %d)", result);
  //   return -1;
  // }

  // result = service.addCharacteristic(&writeChar);
  // if (result != 1) {
  //   LOG_ERR("Failed to add write characteristic (err %d)", result);
  //   return -1;
  // }

  // // Build the service before registering
  // result = service.buildService();
  // if (result != 0) {
  //   LOG_ERR("Failed to build service (err %d)", result);
  //   return -1;
  // }

  // // Add services and the advertisement to the peripheral
  // p1.addAdvertisement(&advertisement);
  // p1.addService(&service);
  // p1.registerServices();

  // // Start advertising
  // int advertising_result = advertisement.startAdvertising();
  // if (advertising_result) {
  //   LOG_ERR("Failed to start advertising (err %d)", advertising_result);
  //   return advertising_result;
  // }

  // Main loop (Zephyr threads will handle advertising & connections)
  while (true) {
    k_sleep(K_SECONDS(1));
  }

  return 0;
}
```

## src/peripheral.cpp
```c
#include "peripheral.hpp"
#include <zephyr/logging/log.h>

LOG_MODULE_REGISTER(PERIPHERAL, LOG_LEVEL_DBG);

// Static array
Peripheral *Peripheral::registry[CONFIG_BT_EXT_ADV_MAX_ADV_SET] = {nullptr};

Peripheral::Peripheral(uint8_t id) : _id(id), _adv(nullptr), _conn(nullptr) {
  struct bt_le_adv_param adv_param = BT_LE_ADV_PARAM_INIT(
      BT_LE_ADV_OPT_EXT_ADV | BT_LE_ADV_OPT_CONN, BT_GAP_ADV_FAST_INT_MIN_2,
      BT_GAP_ADV_FAST_INT_MAX_2, nullptr);

  adv_param.id = id;
  Peripheral::registry[_id] = this;

  int err = bt_le_ext_adv_create(&adv_param, NULL, &_adv);
  if (err) {
    LOG_ERR("Failed to create adv for id %d (err %d)\n", id, err);
  } else {
    LOG_INF("Peripheral %d created adv %p\n", id, _adv);
  }

  static const uint8_t device_name[8 + 1] = "BlueSimI";
  // device_name[7] = '0' + id;
  _adv_data[0] =
      BT_DATA(BT_DATA_NAME_COMPLETE, device_name, sizeof(device_name) - 1);

  err = bt_le_ext_adv_set_data(_adv, _adv_data, 1, nullptr, 0);
  if (err) {
    LOG_ERR("Peripheral %d failed to set adv data (err %d)\n", _id, err);
  }
}

Peripheral::~Peripheral() { Peripheral::registry[_id] = nullptr; }

int Peripheral::start() {
  if (!_adv)
    return -1;

  int err = bt_le_ext_adv_start(_adv, BT_LE_EXT_ADV_START_DEFAULT);
  if (err) {
    LOG_ERR("Peripheral %d failed to start (err %d)\n", _id, err);
  } else {
    LOG_INF("Peripheral %d started advertising\n", _id);
  }
  return err;
}

void Peripheral::onConnected(struct bt_conn *conn) {
  LOG_INF("Peripheral %d connected! conn=%p\n", _id, conn);
}

void Peripheral::onDisconnected(struct bt_conn *conn, uint8_t reason) {
  LOG_WRN("Peripheral %d disconnected (reason %u)\n", _id, reason);
}

// Utility function to map the peripheral from which the connection is coming
// from
Peripheral *Peripheral::fromConn(struct bt_conn *conn) {
  for (Peripheral *p : Peripheral::registry) {
    if (!p)
      continue;

    if (p->_conn == conn) {
      return p;
    }
  }
  return nullptr;
}

void Peripheral::bt_conn_cb_connected(struct bt_conn *conn, uint8_t err) {
  struct bt_conn_info info;
  if (bt_conn_get_info(conn, &info) == 0) {
    uint8_t id = info.id; // This is the local identity (same as adv_param.id)
    Peripheral *p = Peripheral::registry[id];
    if (p) {
      p->_conn = conn;
      p->onConnected(conn);
      return;
    }
  }
}

void Peripheral::bt_conn_cb_disconnected(struct bt_conn *conn, uint8_t reason) {
  Peripheral *p = Peripheral::fromConn(conn);
  if (p) {
    p->onDisconnected(conn, reason);
  } else {
    LOG_WRN("Disconnected connection not associated with any peripheral");
  }
}
```

## src/peripheral.hpp
```c
extern "C" {
#include <zephyr/bluetooth/bluetooth.h>
#include <zephyr/bluetooth/conn.h>
}

class Peripheral {
public:
  Peripheral(uint8_t id);
  virtual ~Peripheral();

  // Called when this peripheral got connected/disconnected
  virtual void onConnected(struct bt_conn *conn);
  virtual void onDisconnected(struct bt_conn *conn, uint8_t reason);

  // Static global connection callbacks
  static void bt_conn_cb_connected(struct bt_conn *conn, uint8_t err);
  static void bt_conn_cb_disconnected(struct bt_conn *conn, uint8_t reason);

  // Start advertising
  int start();

  // Map bt_conn back to Peripheral
  static Peripheral *fromConn(struct bt_conn *conn);

private:
  uint8_t _id;
  struct bt_le_ext_adv *_adv;
  struct bt_data _adv_data[1];
  struct bt_conn *_conn;

  static Peripheral *registry[CONFIG_BT_EXT_ADV_MAX_ADV_SET];
};
```
